## firmware/rx/main/Kconfig.projbuild
```kconfig
menu "Home WiFi"

    config STA_SSID
        string "WiFi network name (2.4 GHz)"
        default ""
        help
            Every board joins this network. The TX and all RXs then share its
            channel, which is the sensing channel. Leave empty here and set it
            per board over serial with STASSID: <name>, so it isn't committed.

    config STA_PASSWORD
        string "WiFi password"
        default ""
        help
            Set over serial with STAPASS: <password>. Stored in the board's
            NVS; never printed back.

endmenu

menu "Debug (RX)"

    config SEND_CSI_TO_SERIAL
        bool "Send CSI data to Serial"
        default "y"
        help
            Prints upstream-compatible CSI_DATA lines to the serial console.

endmenu

menu "Reporting Network Config (RX)"

    config NODE_ID
        string "Node ID (default)"
        default "rx-1"
        help
            Unique ID for this receiver. It appears on every MQTT record and
            in the MQTT topic (<mqtt_topic>/<node_id>/data). Override at
            runtime with serial command NODEID: <id>.

    config MQTT_HOST
        string "MQTT Broker Host (IP or hostname)"
        default ""
        help
            The laptop running mosquitto, by its address on the home WiFi.
            Override at runtime with MQTTHOST: <ip>.

    config MQTT_PORT
        int "MQTT Broker Port"
        default 1883
        range 1 65535

    config MQTT_TOPIC
        string "MQTT Base Topic"
        default "csi"
        help
            Records are published to <mqtt_topic>/<node_id>/data. The hub
            subscribes to <mqtt_topic>/+/data so any number of nodes merge
            into one stream.

endmenu
```

## firmware/tx/main/Kconfig.projbuild
```kconfig
menu "Home WiFi"

    config STA_SSID
        string "WiFi network name (2.4 GHz)"
        default ""
        help
            Every board joins this network. The TX and all RXs then share its
            channel, which is the sensing channel. Leave empty here and set it
            per board over serial with STASSID: <name>, so it isn't committed.

    config STA_PASSWORD
        string "WiFi password"
        default ""
        help
            Set over serial with STAPASS: <password>. Stored in the board's
            NVS; never printed back.

endmenu

menu "Sensing (TX)"

    config PACKET_RATE
        int "Packet TX Rate (packets per second)"
        default "100"
        range 1 1000
        help
            The TX broadcasts this many ESP-NOW frames per second; each RX
            produces one CSI record per frame. Serial command RATE: <n>
            changes it live.

endmenu
```
